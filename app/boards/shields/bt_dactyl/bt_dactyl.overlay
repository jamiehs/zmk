/*
 * Copyright (c) 2021 The ZMK Contributors
 *
 * SPDX-License-Identifier: MIT
 */

#include "bt_dactyl.dtsi"

&kscan0 {
	row-gpios
		= <&gpio0 4  (GPIO_ACTIVE_HIGH | GPIO_PULL_DOWN)>
		, <&gpio0 5  (GPIO_ACTIVE_HIGH | GPIO_PULL_DOWN)>
		, <&gpio0 30 (GPIO_ACTIVE_HIGH | GPIO_PULL_DOWN)>
		, <&gpio0 28 (GPIO_ACTIVE_HIGH | GPIO_PULL_DOWN)>
		, <&gpio0 2  (GPIO_ACTIVE_HIGH | GPIO_PULL_DOWN)>
		, <&gpio0 3  (GPIO_ACTIVE_HIGH | GPIO_PULL_DOWN)>
		, <&gpio0 14 (GPIO_ACTIVE_HIGH | GPIO_PULL_DOWN)>
		, <&gpio0 13 (GPIO_ACTIVE_HIGH | GPIO_PULL_DOWN)>
		;
	col-gpios
		= <&gpio0 12 (GPIO_ACTIVE_HIGH | GPIO_PULL_DOWN)>
		, <&gpio0 11 (GPIO_ACTIVE_HIGH | GPIO_PULL_DOWN)>
		, <&gpio1 8  (GPIO_ACTIVE_HIGH | GPIO_PULL_DOWN)>
		, <&gpio0 7  (GPIO_ACTIVE_HIGH | GPIO_PULL_DOWN)>
		, <&gpio0 26 (GPIO_ACTIVE_HIGH | GPIO_PULL_DOWN)>
		, <&gpio0 27 (GPIO_ACTIVE_HIGH | GPIO_PULL_DOWN)>
		, <&gpio0 6  (GPIO_ACTIVE_HIGH | GPIO_PULL_DOWN)>
		, <&gpio0 8  (GPIO_ACTIVE_HIGH | GPIO_PULL_DOWN)>
		;
};

