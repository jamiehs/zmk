## app/boards/shields/bt_dactyl/Kconfig.defconfig
```kconfig
# Copyright (c) 2021 The ZMK Contributors
# SPDX-License-Identifier: MIT

if SHIELD_BT_DACTYL

config ZMK_KEYBOARD_NAME
	default "Purple Dactyl"
endif
```

## app/boards/shields/bt_dactyl/Kconfig.shield
```kconfig
# Copyright (c) 2021 The ZMK Contributors
# SPDX-License-Identifier: MIT

config SHIELD_BT_DACTYL
	def_bool $(shields_list_contains,bt_dactyl)
```
